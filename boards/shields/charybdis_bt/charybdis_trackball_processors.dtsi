/*
 * Copyright (c) 2025 Justin Keene
 * SPDX-License-Identifier: MIT
 *
 * Common trackball input processor configurations for Charybdis Mini keyboard
 * This file defines the standard processing for scroll and slow pointer modes
 *
 * Usage: Include this file and use CHARYBDIS_TRACKBALL_PROCESSORS macro
 * in your input-listener node
 */

#include "charybdis_layers.h"
#include <dt-bindings/zmk/input_transform.h>
#include <input/processors.dtsi>

// Standard trackball processing configuration
// Can be used in both standalone (trackball_listener) and dongle mode (input_split_listener)
#define CHARYBDIS_TRACKBALL_PROCESSORS \
    /* base processor chain - sensitivity and auto mouse layer */ \
    input-processors = <&zip_xy_scaler 6 6 &zip_temp_layer MOUSE 400>; \
    \
    /* layer-8 scroll override */ \
    scroller: scroller { \
        layers = <SCROLL>; \
        input-processors = < \
            &zip_xy_scaler 4 4 \
            &zip_xy_scaler 2 15 \
            &zip_xy_to_scroll_mapper \
            &zip_scroll_transform (INPUT_TRANSFORM_Y_INVERT) \
        >; \
    }; \
    \
    /* layer-6 slow-pointer override */ \
    slow_pointer: slow_pointer { \
        layers = <SLOW_POINTER>; \
        input-processors = <&zip_xy_scaler 2 6>; \
    };
