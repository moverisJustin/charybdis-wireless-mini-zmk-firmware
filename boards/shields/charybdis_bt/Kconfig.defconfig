## boards/shields/charybdis_bt/Kconfig.defconfig
```kconfig
# Charybdis Mini keyboard default configurations

# Standalone mode - right acts as central
if SHIELD_CHARYBDIS_RIGHT_STANDALONE

config ZMK_KEYBOARD_NAME
	default "Charybdis"

config ZMK_SPLIT_BLE_ROLE_CENTRAL
	default y

endif

# Dongle mode - right acts as peripheral (no central role, no keyboard name)
if SHIELD_DONGLE_CHARYBDIS_RIGHT

config ZMK_KEYBOARD_NAME
	default "Charybdis Right"

endif

# Prospector dongle - acts as central
if SHIELD_DONGLE_PROSPECTOR

config ZMK_KEYBOARD_NAME
	default "Charybdis"

config ZMK_SPLIT_BLE_ROLE_CENTRAL
	default y

endif

# Enable split for all shield variants
if SHIELD_CHARYBDIS_LEFT || SHIELD_CHARYBDIS_RIGHT_STANDALONE || SHIELD_DONGLE_CHARYBDIS_RIGHT || SHIELD_DONGLE_PROSPECTOR

config ZMK_SPLIT
	default y

endif
```

## boards/shields/charybdis_bt/Kconfig.shield
```kconfig
# Charybdis Mini keyboard shield configurations

config SHIELD_CHARYBDIS_LEFT
	def_bool $(shields_list_contains,charybdis_left)

# Standalone mode - right acts as central (BT mode)
config SHIELD_CHARYBDIS_RIGHT_STANDALONE
	def_bool $(shields_list_contains,charybdis_right_standalone)

# Dongle mode - right acts as peripheral
config SHIELD_DONGLE_CHARYBDIS_RIGHT
	def_bool $(shields_list_contains,dongle_charybdis_right)

# Dongle variants
config SHIELD_DONGLE_PROSPECTOR
	def_bool $(shields_list_contains,dongle_prospector)
```

## config/west.yml
```yaml
manifest:
  remotes:
    - name: zmkfirmware
      url-base: https://github.com/zmkfirmware

    - name: 280Zo
      url-base: https://github.com/280Zo

    - name: moverisJustin
      url-base: https://github.com/moverisJustin

  projects:
    - name: zmk
      remote: zmkfirmware
      revision: main
      import: app/west.yml

    - name: zmk-dongle-screen
      remote: moverisJustin
      revision: e6b2115f3e0b2ec8a94554c23a24728ef52c775c

  self:
    path: config
```

## zmk-maccel/Kconfig
```kconfig
config ZMK_INPUT_PROCESSOR_MACCEL
    bool "Mouse acceleration input processor"
    default y
    help
      Enable velocity-based mouse acceleration for trackballs.
      This processor scales mouse movement based on velocity,
      providing precision for slow movements and speed for fast sweeps.
```

## zmk-maccel/dts/bindings/zmk,input-processor-maccel.yaml
```yaml
description: |
  Mouse acceleration input processor for ZMK.
  Applies velocity-based scaling to trackball input, providing
  precision for slow movements and speed for fast sweeps.

compatible: "zmk,input-processor-maccel"

properties:
  "#input-processor-cells":
    type: int
    required: true
    const: 0
    description: Number of cells in the input processor specifier (always 0 for maccel)

  track-remainders:
    type: boolean
    description: Whether to track remainders for this processor (for ZMK input system)

  slow-threshold:
    type: int
    default: 5
    description: |
      Velocity threshold (distance/ms) below which slow-factor is applied.
      Lower values make slow mode more sensitive.

  fast-threshold:
    type: int
    default: 20
    description: |
      Velocity threshold (distance/ms) above which full speed (100%) is applied.
      Values between slow and fast thresholds use med-factor.

  slow-factor:
    type: int
    default: 30
    description: |
      Multiplication factor (as percentage) for slow movements.
      30 = 30% of original movement. Lower values = more precision.

  med-factor:
    type: int
    default: 60
    description: |
      Multiplication factor (as percentage) for medium-speed movements.
      60 = 60% of original movement.
```
